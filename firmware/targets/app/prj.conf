## CMakeLists.txt
```
cmake_minimum_required(VERSION 3.20.0)

find_package(Zephyr REQUIRED HINTS $ENV{ZEPHYR_BASE})
project(App)

target_include_directories(app
    PRIVATE
        ${CMAKE_CURRENT_SOURCE_DIR}/src
)

target_sources(app
    PRIVATE
        ${CMAKE_CURRENT_SOURCE_DIR}/src/main.cpp
)

target_link_libraries(app
    PRIVATE
        zephyr_interface
        Components::Foo
)
```

## prj.conf
```kconfig
# enable c++ support
CONFIG_EXTERNAL_LIBC=y # use newlib over minimal
CONFIG_CPLUSPLUS=y
CONFIG_LIB_CPLUSPLUS=y
CONFIG_STD_CPP20=y
CONFIG_CBPRINTF_LIBC_SUBSTS=y
CONFIG_CBPRINTF_FP_SUPPORT=y

CONFIG_FOO_COMPONENT=y
```

## src/main.cpp
```c
#include <foo/hello.hpp>

int main(int argc, char **argv)
{
    return foo::sayHello();
}
```
