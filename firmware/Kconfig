## firmware/Kconfig
```kconfig
# This Kconfig file is picked by the Zephyr build system because it is defined
# as the module Kconfig entry point (see zephyr/module.yml). You can browse
# module options by going to Zephyr -> Modules in Kconfig.

rsource "components/Kconfig"

config APP_GTEST
    bool "GoogleTest support"
    depends on CPLUSPLUS && BOARD_NATIVE_POSIX
    help
      This option enables GoogleTest support in the application.
```

## firmware/components/foo/Kconfig
```kconfig
rsource "tests/Kconfig"

config FOO_COMPONENT
    bool "Enable the Foo component"
```

## firmware/components/foo/tests/Kconfig
```kconfig
config FOO_COMPONENT_TESTS
    bool "Enable Foo component tests"
    depends on APP_GTEST && FOO_COMPONENT
```

## firmware/west.yml
```yaml
manifest:
  remotes: # short names for project URLs
    - name: zephyr-project
      url-base: https://github.com/zephyrproject-rtos
  projects: # a list of projects managed by west
    - name: zephyr
      remote: zephyr-project
      revision: zephyr-v3.0.0
      west-commands: scripts/west-commands.yml
  self: # configuration related to the manifest repository itself, i.e. the repository containing west.yml
    path: zephyr-vscode-template
```
